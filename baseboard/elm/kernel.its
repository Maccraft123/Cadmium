## baseboard/elm/kernel.its
```
/dts-v1/;

/ {
	images {
		kernel@1{
			description = "kernel";
			data = /incbin/("c_linux.lz4");
			type = "kernel_noload";
			arch = "arm64";
			os = "linux";
			compression = "lz4";
			load = <0>;
			entry = <0>;
		};
		fdt@1{
			description = "mt8173-elm.dts";
			data = /incbin/("arch/arm64/boot/dts/rockchip/mt8173-elm.dts");
			type = "flat_dt";
			arch = "arm64";
			compression = "none";
			hash@1{
				algo = "sha1";
			};
		};
		fdt@2{
			description = "mt8173-elm-hana.dts";
			data = /incbin/("arch/arm64/boot/dts/rockchip/mt8173-elm-hana.dts");
			type = "flat_dt";
			arch = "arm64";
			compression = "none";
			hash@1{
				algo = "sha1";
			};
		};
		fdt@3{
			description = "mt8173-elm-hana-rev7.dts";
			data = /incbin/("arch/arm64/boot/dts/rockchip/mt8173-elm-hana-rev7.dts");
			type = "flat_dt";
			arch = "arm64";
			compression = "none";
			hash@1{
				algo = "sha1";
			};
		};
	};
	configurations {
		default = "conf@1";
		conf@1{
			kernel = "kernel@1";
			fdt = "fdt@1";
		};
		conf@2{
			kernel = "kernel@1";
			fdt = "fdt@2";
		};
		conf@3{
			kernel = "kernel@1";
			fdt = "fdt@3";
		};
	};
};
```

## baseboard/kukui/kernel.its
```
/dts-v1/;

/ {
	images {
		kernel@1{
			description = "kernel";
			data = /incbin/("arch/arm64/boot/Image");
			type = "kernel_noload";
			arch = "arm64";
			os = "linux";
			compression = "none";
			load = <0>;
			entry = <0>;
		};
		fdt@1{
			description = "mt8183-kukui-krane-sku176.dtb";
			data = /incbin/("arch/arm64/boot/dts/mediatek/mt8183-kukui-krane-sku176.dtb");
			type = "flat_dt";
			arch = "arm64";
			compression = "none";
			hash@1{
				algo = "sha1";
			};
		};
		fdt@2{
			description = "mt8183-kukui-krane-sku0.dtb";
			data = /incbin/("arch/arm64/boot/dts/mediatek/mt8183-kukui-krane-sku0.dtb");
			type = "flat_dt";
			arch = "arm64";
			compression = "none";
			hash@1{
				algo = "sha1";
			};
		};
		fdt@3{
			description = "mt8183-kukui-jacuzzi-juniper-sku16.dtb";
			data = /incbin/("arch/arm64/boot/dts/mediatek/mt8183-kukui-jacuzzi-juniper-sku16.dtb");
			type = "flat_dt";
			arch = "arm64";
			compression = "none";
			hash@1{
				algo = "sha1";
			};
		};
	};
	configurations {
		default = "conf@1";
		conf@1{
			kernel = "kernel@1";
			fdt = "fdt@1";
		};
		conf@2{
			kernel = "kernel@1";
			fdt = "fdt@2";
		};
		conf@3{
			kernel = "kernel@1";
			fdt = "fdt@3";
		};
	};
};
```

## baseboard/trogdor/kernel.its
```
/dts-v1/;

/ {
	images {
		kernel@1{
			description = "kernel";
			data = /incbin/("c_linux.lz4");
			type = "kernel_noload";
			arch = "arm64";
			os = "linux";
			compression = "lz4";
			load = <0>;
			entry = <0>;
		};
		fdt@1{
			description = "sc7180-trogdor-lazor-r1.dtb";
			data = /incbin/("arch/arm64/boot/dts/qcom/sc7180-trogdor-lazor-r1.dtb");
			type = "flat_dt";
			arch = "arm64";
			compression = "none";
			hash@1{
				algo = "sha1";
			};
		};
		fdt@2{
			description = "sc7180-trogdor-lazor-r1-kb.dtb";
			data = /incbin/("arch/arm64/boot/dts/qcom/sc7180-trogdor-lazor-r1-kb.dtb");
			type = "flat_dt";
			arch = "arm64";
			compression = "none";
			hash@1{
				algo = "sha1";
			};
		};
		fdt@3{
			description = "sc7180-trogdor-lazor-r1-lte.dtb";
			data = /incbin/("arch/arm64/boot/dts/qcom/sc7180-trogdor-lazor-r1-lte.dtb");
			type = "flat_dt";
			arch = "arm64";
			compression = "none";
			hash@1{
				algo = "sha1";
			};
		};
		fdt@4{
			description = "sc7180-trogdor-lazor-r3.dtb";
			data = /incbin/("arch/arm64/boot/dts/qcom/sc7180-trogdor-lazor-r3.dtb");
			type = "flat_dt";
			arch = "arm64";
			compression = "none";
			hash@1{
				algo = "sha1";
			};
		};
		fdt@5{
			description = "sc7180-trogdor-lazor-r3-kb.dtb";
			data = /incbin/("arch/arm64/boot/dts/qcom/sc7180-trogdor-lazor-r3-kb.dtb");
			type = "flat_dt";
			arch = "arm64";
			compression = "none";
			hash@1{
				algo = "sha1";
			};
		};
		fdt@6{
			description = "sc7180-trogdor-lazor-r3-lte.dtb";
			data = /incbin/("arch/arm64/boot/dts/qcom/sc7180-trogdor-lazor-r3-lte.dtb");
			type = "flat_dt";
			arch = "arm64";
			compression = "none";
			hash@1{
				algo = "sha1";
			};
		};

	};
	configurations {
		default = "conf@1";
		conf@1{
			kernel = "kernel@1";
			fdt = "fdt@1";
		};
		conf@2{
			kernel = "kernel@1";    
			fdt = "fdt@2";
		};
		conf@3{
			kernel = "kernel@1";    
			fdt = "fdt@3";
		};
		conf@4{
			kernel = "kernel@1";    
			fdt = "fdt@4";
		};
		conf@5{
			kernel = "kernel@1";    
			fdt = "fdt@5";
		};
		conf@6{
			kernel = "kernel@1";    
			fdt = "fdt@6";
		};

	};
};
```

## board/duet/kernel.its
```
/dts-v1/;

/ {
    images {
        kernel@1{
            description = "kernel";
            data = /incbin/("arch/arm64/boot/Image");
            type = "kernel_noload";
            arch = "arm64";
            os = "linux";
            compression = "none";
            load = <0>;
            entry = <0>;
        };
        fdt@1{
            description = "mt8183-kukui-krane.dtb";
            data = /incbin/("arch/arm64/boot/dts/mediatek/mt8183-kukui-krane-sku176.dtb");
            type = "flat_dt";
            arch = "arm64";
            compression = "none";
            hash@1{
                algo = "sha1";
            };
        };
    };
    configurations {
        default = "conf@1";
        conf@1{
            kernel = "kernel@1";
            fdt = "fdt@1";
        };
    };
};
```

## kernel/arm.kernel.its
```
/dts-v1/;

/ {
	images {
		kernel@1{
			description = "kernel";
			data = /incbin/("arch/arm/boot/zImage");
			type = "kernel_noload";
			arch = "arm";
			os = "linux";
			load = <0>;
			entry = <0>;
		};
		fdt@1 {
			description = "rk3288-veyron-speedy.dtb";
			data = /incbin/("arch/arm/boot/dts/rk3288-veyron-speedy.dtb");
			type = "flat_dt";
			arch = "arm";
			compression = "none";
			hash {
				algo = "sha1";
			};
		};
		fdt@2 {
			description = "rk3288-veyron-minniedtb";
			data = /incbin/("arch/arm/boot/dts/rk3288-veyron-minnie.dtb");
			type = "flat_dt";
			arch = "arm";
			compression = "none";
			hash {
				algo = "sha1";
			};
		};
	};
	configurations {
		conf@1{
			kernel = "kernel@1";
			fdt = "fdt@1";
		};
		conf@2{
			kernel = "kernel@1";    
			fdt = "fdt@2";
		};
	};
};
```

## kernel/arm64.kernel.its
```
/dts-v1/;

/ {
	images {
		kernel@1{
			description = "kernel";
			data = /incbin/("c_linux.lz4");
			type = "kernel_noload";
			arch = "arm64";
			os = "linux";
			compression = "lz4";
			load = <0>;
			entry = <0>;
		};
		fdt@1{
			description = "rk3399-gru-kevin.dtb";
			data = /incbin/("arch/arm64/boot/dts/rockchip/rk3399-gru-kevin.dtb");
			type = "flat_dt";
			arch = "arm64";
			compression = "none";
			hash@1{
				algo = "sha1";
			};
		};
		fdt@2{
			description = "rk3399-gru-bob.dtb";
			data = /incbin/("arch/arm64/boot/dts/rockchip/rk3399-gru-bob.dtb");
			type = "flat_dt";
			arch = "arm64";
			compression = "none";
			hash@1{
				algo = "sha1";
			};
		};
		fdt@3{
			description = "mt8183-kukui-krane-sku176.dtb";
			data = /incbin/("arch/arm64/boot/dts/mediatek/mt8183-kukui-krane-sku176.dtb");
			type = "flat_dt";
			arch = "arm64";
			compression = "none";
			hash@1{
				algo = "sha1";
			};
		};
		fdt@4{
			description = "mt8183-kukui-krane-sku0.dtb";
			data = /incbin/("arch/arm64/boot/dts/mediatek/mt8183-kukui-krane-sku0.dtb");
			type = "flat_dt";
			arch = "arm64";
			compression = "none";
			hash@1{
				algo = "sha1";
			};
		};
		fdt@5{
			description = "sc7180-trogdor-lazor-r1.dtb";
			data = /incbin/("arch/arm64/boot/dts/qcom/sc7180-trogdor-lazor-r1.dtb");
			type = "flat_dt";
			arch = "arm64";
			compression = "none";
			hash@1{
				algo = "sha1";
			};
		};
		fdt@6{
			description = "sc7180-trogdor-lazor-r1-kb.dtb";
			data = /incbin/("arch/arm64/boot/dts/qcom/sc7180-trogdor-lazor-r1-kb.dtb");
			type = "flat_dt";
			arch = "arm64";
			compression = "none";
			hash@1{
				algo = "sha1";
			};
		};
		fdt@7{
			description = "sc7180-trogdor-lazor-r1-lte.dtb";
			data = /incbin/("arch/arm64/boot/dts/qcom/sc7180-trogdor-lazor-r1-lte.dtb");
			type = "flat_dt";
			arch = "arm64";
			compression = "none";
			hash@1{
				algo = "sha1";
			};
		};
		fdt@8{
			description = "sc7180-trogdor-lazor-r3.dtb";
			data = /incbin/("arch/arm64/boot/dts/qcom/sc7180-trogdor-lazor-r3.dtb");
			type = "flat_dt";
			arch = "arm64";
			compression = "none";
			hash@1{
				algo = "sha1";
			};
		};
		fdt@9{
			description = "sc7180-trogdor-lazor-r3-kb.dtb";
			data = /incbin/("arch/arm64/boot/dts/qcom/sc7180-trogdor-lazor-r3-kb.dtb");
			type = "flat_dt";
			arch = "arm64";
			compression = "none";
			hash@1{
				algo = "sha1";
			};
		};
		fdt@10{
			description = "sc7180-trogdor-lazor-r3-lte.dtb";
			data = /incbin/("arch/arm64/boot/dts/qcom/sc7180-trogdor-lazor-r3-lte.dtb");
			type = "flat_dt";
			arch = "arm64";
			compression = "none";
			hash@1{
				algo = "sha1";
			};
		};
		fdt@11{
			description = "sc7180-trogdor-homestar-r2.dtb";
			data = /incbin/("arch/arm64/boot/dts/qcom/sc7180-trogdor-homestar-r2.dtb");
			type = "flat_dt";
			arch = "arm64";
			compression = "none";
			hash@1{
				algo = "sha1";
			};
		};
		fdt@12{
			description = "sc7180-trogdor-homestar-r3.dtb";
			data = /incbin/("arch/arm64/boot/dts/qcom/sc7180-trogdor-homestar-r3.dtb");
			type = "flat_dt";
			arch = "arm64";
			compression = "none";
			hash@1{
				algo = "sha1";
			};
		};
		fdt@13{
			description = "sc7180-trogdor-coachz-r1.dtb";
			data = /incbin/("arch/arm64/boot/dts/qcom/sc7180-trogdor-coachz-r1.dtb");
			type = "flat_dt";
			arch = "arm64";
			compression = "none";
			hash@1{
				algo = "sha1";
			};
		};
		fdt@14{
			description = "sc7180-trogdor-coachz-r1-lte.dtb";
			data = /incbin/("arch/arm64/boot/dts/qcom/sc7180-trogdor-coachz-r1-lte.dtb");
			type = "flat_dt";
			arch = "arm64";
			compression = "none";
			hash@1{
				algo = "sha1";
			};
		};
		fdt@15{
			description = "sc7180-trogdor-coachz-r3.dtb";
			data = /incbin/("arch/arm64/boot/dts/qcom/sc7180-trogdor-coachz-r3.dtb");
			type = "flat_dt";
			arch = "arm64";
			compression = "none";
			hash@1{
				algo = "sha1";
			};
		};
		fdt@16{
			description = "sc7180-trogdor-coachz-r3-lte.dtb";
			data = /incbin/("arch/arm64/boot/dts/qcom/sc7180-trogdor-coachz-r3-lte.dtb");
			type = "flat_dt";
			arch = "arm64";
			compression = "none";
			hash@1{
				algo = "sha1";
			};
		};
		fdt@17{
			description = "mt8183-kukui-kodama-sku16.dtb";
			data = /incbin/("arch/arm64/boot/dts/mediatek/mt8183-kukui-kodama-sku16.dtb");
			type = "flat_dt";
			arch = "arm64";
			compression = "none";
			hash@1{
				algo = "sha1";
			};
		};
		fdt@18{
			description = "mt8183-kukui-kodama-sku272.dtb";
			data = /incbin/("arch/arm64/boot/dts/mediatek/mt8183-kukui-kodama-sku272.dtb");
			type = "flat_dt";
			arch = "arm64";
			compression = "none";
			hash@1{
				algo = "sha1";
			};
		};
		fdt@19{
			description = "mt8183-kukui-kodama-sku288.dtb";
			data = /incbin/("arch/arm64/boot/dts/mediatek/mt8183-kukui-kodama-sku288.dtb");
			type = "flat_dt";
			arch = "arm64";
			compression = "none";
			hash@1{
				algo = "sha1";
			};
		};
		fdt@20{
			description = "mt8183-kukui-kodama-sku32.dtb";
			data = /incbin/("arch/arm64/boot/dts/mediatek/mt8183-kukui-kodama-sku32.dtb");
			type = "flat_dt";
			arch = "arm64";
			compression = "none";
			hash@1{
				algo = "sha1";
			};
		};
		fdt@21{
			description = "mt8173-elm-hana.dtb";
			data = /incbin/("arch/arm64/boot/dts/mediatek/mt8173-elm-hana.dtb");
			type = "flat_dt";
			arch = "arm64";
			compression = "none";
			hash@1{
				algo = "sha1";
			};
		};
	};
	configurations {
		conf@1{
			kernel = "kernel@1";
			fdt = "fdt@1";
		};
		conf@2{
			kernel = "kernel@1";    
			fdt = "fdt@2";
		};
		conf@3{
			kernel = "kernel@1";    
			fdt = "fdt@3";
		};
		conf@4{
			kernel = "kernel@1";    
			fdt = "fdt@4";
		};
		conf@5{
			kernel = "kernel@1";    
			fdt = "fdt@5";
		};
		conf@6{
			kernel = "kernel@1";    
			fdt = "fdt@6";
		};
		conf@7{
			kernel = "kernel@1";
			fdt = "fdt@7";
		};
		conf@8{
			kernel = "kernel@1";
			fdt = "fdt@8";
		};
		conf@9{
			kernel = "kernel@1";
			fdt = "fdt@9";
		};
		conf@10{
			kernel = "kernel@1";
			fdt = "fdt@10";
		};
		conf@11{
			kernel = "kernel@1";
			fdt = "fdt@11";
		};
		conf@12{
			kernel = "kernel@1";
			fdt = "fdt@12";
		};
		conf@13{
			kernel = "kernel@1";
			fdt = "fdt@13";
		};
		conf@14{
			kernel = "kernel@1";
			fdt = "fdt@14";
		};
		conf@15{
			kernel = "kernel@1";
			fdt = "fdt@15";
		};
		conf@16{
			kernel = "kernel@1";
			fdt = "fdt@16";
		};
		conf@17{
			kernel = "kernel@1";
			fdt = "fdt@17";
		};
		conf@18{
			kernel = "kernel@1";
			fdt = "fdt@18";
		};
		conf@19{
			kernel = "kernel@1";
			fdt = "fdt@19";
		};
		conf@20{
			kernel = "kernel@1";
			fdt = "fdt@20";
		};
		conf@21{
			kernel = "kernel@1";
			fdt = "fdt@21";
		};
	};
};
```
